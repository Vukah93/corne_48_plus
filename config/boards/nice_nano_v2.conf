## config/boards/nice_nano_v2.conf
```kconfig
# Enable split keyboard support
CONFIG_ZMK_SPLIT=y

# Enable a basic single-color backlight
CONFIG_ZMK_BACKLIGHT=y # Nếu bạn chỉ muốn bật/tắt đèn nền đơn sắc
# CONFIG_ZMK_RGB_LIGHTING=y # Nếu bạn có RGB LED và muốn điều khiển chúng

# Enable encoder support
CONFIG_ZMK_EXT_POWER=y # Encoder thường cần nguồn ngoài
CONFIG_EC11_DRIVER=y # Bật trình điều khiển cho encoder EC11

# Enable joystick support (nếu bạn đang dùng loại joystick được hỗ trợ)
# Joystick trong ZMK phức tạp hơn một chút, chúng ta sẽ cần behavior tùy chỉnh sau.
CONFIG_ADC=y # Kích hoạt ADC cho joystick analog

# Power saving (cấu hình cho Bluetooth)
CONFIG_ZMK_SLEEP=y
CONFIG_PM_DEVICE=y
CONFIG_PM_DEVICE_RUNTIME=y

# Define the number of rows and columns for your matrix (Corne has 5 rows, 6 columns per half)
# These values will be used by Kscan in your overlay, it's good to define them here too.
CONFIG_ZMK_MATRIX_ROWS=5
CONFIG_ZMK_MATRIX_COLS=6

# Increase the number of available encoders if you have more than one
CONFIG_ZMK_ENCODER_COUNT=1 # Hoặc 2 nếu mỗi bên có 1 encoder
```
